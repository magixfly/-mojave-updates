// car.cpp - Car mode: access point + web page + WebSocket with raw CRSF frames (V1.4)
#include "car.h"
#include <WiFi.h>
#include <esp_wifi.h>
#include <esp_http_server.h>
#include "car_page.h"     // generated by tools/mkpage.py from web/car.html (gzip)

static httpd_handle_t srv = nullptr;
static bool active = false;
static String apSsid, verStr;
static uint8_t apCh = 1;

// ---------------------------------------------------------------- frame buffer (filled by the receiver, sent by carLoop)
static uint8_t buf[3072];
static size_t blen = 0;
static portMUX_TYPE mux = portMUX_INITIALIZER_UNLOCKED;
static uint32_t lastSend = 0;

void carFrame(const uint8_t* f, size_t n) {
  if (!active || n == 0 || n > 64) return;
  portENTER_CRITICAL(&mux);
  if (blen + n > sizeof(buf)) blen = 0;          // nobody reads fast enough -> drop old data
  memcpy(buf + blen, f, n);
  blen += n;
  portEXIT_CRITICAL(&mux);
}

// ---------------------------------------------------------------- HTTP handlers
static esp_err_t hRoot(httpd_req_t* r) {
  httpd_resp_set_type(r, "text/html; charset=utf-8");
  httpd_resp_set_hdr(r, "Content-Encoding", "gzip");
  httpd_resp_set_hdr(r, "Cache-Control", "no-cache");
  return httpd_resp_send(r, (const char*)CAR_PAGE, CAR_PAGE_LEN);
}

static esp_err_t hInfo(httpd_req_t* r) {
  char j[200];
  snprintf(j, sizeof(j), "{\"ver\":\"%s\",\"ssid\":\"%s\",\"ch\":%u,\"cl\":%d,\"ws\":%d,\"up\":%lu,\"heap\":%u}",
           verStr.c_str(), apSsid.c_str(), apCh, carClients(), carWsClients(), (unsigned long)(millis() / 1000),
           (unsigned)ESP.getFreeHeap());
  httpd_resp_set_type(r, "application/json");
  httpd_resp_set_hdr(r, "Cache-Control", "no-cache");
  return httpd_resp_sendstr(r, j);
}

// Android asks these to test for internet. No answer = "no internet" -> the box keeps using its SIM for the map tiles.
static esp_err_t h404(httpd_req_t* r) {
  httpd_resp_send_404(r);
  return ESP_OK;
}

static esp_err_t hWs(httpd_req_t* r) {
  if (r->method == HTTP_GET) return ESP_OK;      // handshake done
  httpd_ws_frame_t f = {};
  f.type = HTTPD_WS_TYPE_TEXT;
  esp_err_t e = httpd_ws_recv_frame(r, &f, 0);   // read length only, the page sends nothing important
  if (e != ESP_OK) return e;
  if (f.len && f.len < 256) {
    uint8_t tmp[256];
    f.payload = tmp;
    httpd_ws_recv_frame(r, &f, f.len);
  }
  return ESP_OK;
}

// ---------------------------------------------------------------- sending (runs inside the HTTP server task)
struct Job { size_t n; uint8_t d[]; };

static void sendJob(void* arg) {
  Job* j = (Job*)arg;
  if (srv) {
    size_t fds = 8;
    int list[8];
    if (httpd_get_client_list(srv, &fds, list) == ESP_OK) {
      for (size_t i = 0; i < fds; i++) {
        if (httpd_ws_get_fd_info(srv, list[i]) != HTTPD_WS_CLIENT_WEBSOCKET) continue;
        httpd_ws_frame_t f = {};
        f.type = HTTPD_WS_TYPE_BINARY;
        f.payload = j->d;
        f.len = j->n;
        f.final = true;
        httpd_ws_send_frame_async(srv, list[i], &f);
      }
    }
  }
  free(j);
}

int carWsClients() {
  if (!srv) return 0;
  size_t fds = 8;
  int list[8], n = 0;
  if (httpd_get_client_list(srv, &fds, list) != ESP_OK) return 0;
  for (size_t i = 0; i < fds; i++)
    if (httpd_ws_get_fd_info(srv, list[i]) == HTTPD_WS_CLIENT_WEBSOCKET) n++;
  return n;
}

int carClients() {
  if (!active) return 0;
  return WiFi.softAPgetStationNum();
}

bool carActive() { return active; }

void carLoop() {
  if (!active || !srv) return;
  uint32_t now = millis();
  if (now - lastSend < 40) return;
  lastSend = now;
  if (!blen) return;
  if (carWsClients() == 0) { portENTER_CRITICAL(&mux); blen = 0; portEXIT_CRITICAL(&mux); return; }
  Job* j = (Job*)malloc(sizeof(Job) + sizeof(buf));
  if (!j) return;
  portENTER_CRITICAL(&mux);
  memcpy(j->d, buf, blen);
  j->n = blen;
  blen = 0;
  portEXIT_CRITICAL(&mux);
  if (httpd_queue_work(srv, sendJob, j) != ESP_OK) free(j);
}

// ---------------------------------------------------------------- start / stop
bool carBegin(const char* ssid, const char* pass, uint8_t ch, bool hidden, const char* ver) {
  apSsid = ssid; verStr = ver; apCh = ch ? ch : 1;
  wifi_mode_t m = WIFI_MODE_NULL;
  esp_wifi_get_mode(&m);
  if (m != WIFI_MODE_APSTA) esp_wifi_set_mode(WIFI_MODE_APSTA);   // keeps the STA side (ESP-NOW, promiscuous) running
  const char* pw = (pass && strlen(pass) >= 8) ? pass : nullptr;  // < 8 characters -> open network
  if (!WiFi.softAP(ssid, pw, apCh, hidden ? 1 : 0, 4)) return false;
  esp_wifi_set_ps(WIFI_PS_NONE);

  httpd_config_t c = HTTPD_DEFAULT_CONFIG();
  c.server_port = 80;
  c.max_open_sockets = 7;
  c.lru_purge_enable = true;
  c.stack_size = 6144;
  c.max_uri_handlers = 12;
  if (httpd_start(&srv, &c) != ESP_OK) { srv = nullptr; return false; }

  static const httpd_uri_t uRoot = {"/", HTTP_GET, hRoot, nullptr};
  static const httpd_uri_t uIdx = {"/index.html", HTTP_GET, hRoot, nullptr};
  static const httpd_uri_t uInfo = {"/api/info", HTTP_GET, hInfo, nullptr};
  httpd_uri_t uWs = {};
  uWs.uri = "/ws"; uWs.method = HTTP_GET; uWs.handler = hWs; uWs.is_websocket = true;
  static const httpd_uri_t u204 = {"/generate_204", HTTP_GET, h404, nullptr};
  httpd_register_uri_handler(srv, &uRoot);
  httpd_register_uri_handler(srv, &uIdx);
  httpd_register_uri_handler(srv, &uInfo);
  httpd_register_uri_handler(srv, &uWs);
  httpd_register_uri_handler(srv, &u204);
  active = true;
  return true;
}

void carStop() {
  active = false;
  if (srv) { httpd_stop(srv); srv = nullptr; }
  WiFi.softAPdisconnect(true);
  esp_wifi_set_mode(WIFI_MODE_STA);
}
